## app/video_test/Kconfig
```kconfig
#
# ESP32-P4X SC2336 V4L2 video capture test.
#

config LVX_USE_DEMO_CONTEST2026_031_VIDEO_TEST
	bool "ESP32-P4X SC2336 video capture test"
	depends on ARCH_BOARD_ESP32P4_FUNCTION_EV_BOARD
	depends on ESP32P4_FUNCTION_EV_BOARD_CAMERA_SC2336_VIDEO
	default n
	---help---
		Build video_test, a V4L2 acceptance program for the P4X SC2336
		camera.  It opens the board-registered /dev/video0 device, negotiates
		the fixed 1024x600 RGB565 format, and verifies bounded continuous
		capture with three USERPTR buffers.  It does not initialize camera
		hardware directly and cannot be enabled with the csi_probe RAW
		diagnostic.
```

## packages/cAGENT/Kconfig
```kconfig
menuconfig CAGENT
    bool "cAGENT core library"
    default n
    help
      Portable C Agent core library for embedded and host platforms.

if CAGENT

menu "Configuration profile"

config CAGENT_PROFILE_TINY_DEFAULTS
    bool
    default n

config CAGENT_PROFILE_REACT_DEFAULTS
    bool
    default n

choice CAGENT_CONFIG_PROFILE
    prompt "cAGENT configuration profile"
    default CAGENT_CONFIG_PROFILE_TINY if CAGENT_PROFILE_TINY_DEFAULTS
    default CAGENT_CONFIG_PROFILE_REACT if CAGENT_PROFILE_REACT_DEFAULTS
    default CAGENT_CONFIG_PROFILE_DEFAULT
    help
      Select a default tuning profile. Applications may select one of the
      hidden *_DEFAULTS symbols to request a profile without forcing users
      to edit every buffer and capacity option manually.

config CAGENT_CONFIG_PROFILE_TINY
    bool "Tiny embedded"
    help
      Lower memory defaults for simple single-tool or mock-model tests.

config CAGENT_CONFIG_PROFILE_DEFAULT
    bool "Default chat"
    help
      Balanced defaults for small chat and tool demos.

config CAGENT_CONFIG_PROFILE_REACT
    bool "ReAct tools"
    help
      Larger defaults for multi-tool ReAct demos, OpenAI-compatible tool
      schemas, Markdown skills and short conversation history.

config CAGENT_CONFIG_PROFILE_CUSTOM
    bool "Custom"
    help
      Keep profile defaults disabled so each option can be tuned directly.

endchoice

config CAGENT_ADVANCED_CONFIG
    bool "Show advanced cAGENT tuning options"
    default n
    help
      Show detailed capacity, buffer and runtime knobs. Leave disabled for
      the common profile-based configuration path.

endmenu

menu "Capacity limits"
    visible if CAGENT_ADVANCED_CONFIG

config CAGENT_MAX_TOOLS
    int "Maximum registered tools"
    default 8 if CAGENT_CONFIG_PROFILE_TINY || CAGENT_PROFILE_TINY_DEFAULTS
    default 16 if CAGENT_CONFIG_PROFILE_REACT || CAGENT_PROFILE_REACT_DEFAULTS
    default 12

config CAGENT_MAX_SKILLS
    int "Maximum registered skills"
    default 4 if CAGENT_CONFIG_PROFILE_TINY || CAGENT_PROFILE_TINY_DEFAULTS
    default 8 if CAGENT_CONFIG_PROFILE_REACT || CAGENT_PROFILE_REACT_DEFAULTS
    default 8

config CAGENT_MAX_CONTEXT_PROVIDERS
    int "Maximum context providers"
    default 4 if CAGENT_CONFIG_PROFILE_TINY || CAGENT_PROFILE_TINY_DEFAULTS
    default 8 if CAGENT_CONFIG_PROFILE_REACT || CAGENT_PROFILE_REACT_DEFAULTS
    default 8

config CAGENT_MAX_SESSIONS
    int "Maximum sessions"
    default 2 if CAGENT_CONFIG_PROFILE_TINY || CAGENT_PROFILE_TINY_DEFAULTS
    default 4 if CAGENT_CONFIG_PROFILE_REACT || CAGENT_PROFILE_REACT_DEFAULTS
    default 4

config CAGENT_MAX_SESSION_MESSAGES
    int "Maximum messages per session"
    default 12 if CAGENT_CONFIG_PROFILE_TINY || CAGENT_PROFILE_TINY_DEFAULTS
    default 24 if CAGENT_CONFIG_PROFILE_REACT || CAGENT_PROFILE_REACT_DEFAULTS
    default 24

endmenu

menu "Context and buffer budget"
    visible if CAGENT_ADVANCED_CONFIG

config CAGENT_CONTEXT_BUFFER_SIZE
    int "Context buffer size"
    default 2048 if CAGENT_CONFIG_PROFILE_TINY || CAGENT_PROFILE_TINY_DEFAULTS
    default 4096 if CAGENT_CONFIG_PROFILE_REACT || CAGENT_PROFILE_REACT_DEFAULTS
    default 4096
    help
      Compatibility base size used as the default for all split buffers
      below when they are not set explicitly.

config CAGENT_SYSTEM_CONTEXT_BUFFER_SIZE
    int "System/context buffer size"
    default 2048 if CAGENT_CONFIG_PROFILE_TINY || CAGENT_PROFILE_TINY_DEFAULTS
    default 4096 if CAGENT_CONFIG_PROFILE_REACT || CAGENT_PROFILE_REACT_DEFAULTS
    default CAGENT_CONTEXT_BUFFER_SIZE

config CAGENT_TOOL_SCHEMA_BUFFER_SIZE
    int "Tool schema buffer size"
    default 4096 if CAGENT_CONFIG_PROFILE_TINY || CAGENT_PROFILE_TINY_DEFAULTS
    default 8192 if CAGENT_CONFIG_PROFILE_REACT || CAGENT_PROFILE_REACT_DEFAULTS
    default CAGENT_CONTEXT_BUFFER_SIZE

config CAGENT_MESSAGES_BUFFER_SIZE
    int "Session messages buffer size"
    default 2048 if CAGENT_CONFIG_PROFILE_TINY || CAGENT_PROFILE_TINY_DEFAULTS
    default 4096 if CAGENT_CONFIG_PROFILE_REACT || CAGENT_PROFILE_REACT_DEFAULTS
    default CAGENT_CONTEXT_BUFFER_SIZE

config CAGENT_HTTP_REQUEST_BUFFER_SIZE
    int "OpenAI-compatible HTTP request buffer size"
    default 4096 if CAGENT_CONFIG_PROFILE_TINY || CAGENT_PROFILE_TINY_DEFAULTS
    default 12288 if CAGENT_CONFIG_PROFILE_REACT || CAGENT_PROFILE_REACT_DEFAULTS
    default CAGENT_CONTEXT_BUFFER_SIZE

config CAGENT_HTTP_RESPONSE_BUFFER_SIZE
    int "OpenAI-compatible HTTP response buffer size"
    default 4096 if CAGENT_CONFIG_PROFILE_TINY || CAGENT_PROFILE_TINY_DEFAULTS
    default 8192 if CAGENT_CONFIG_PROFILE_REACT || CAGENT_PROFILE_REACT_DEFAULTS
    default CAGENT_CONTEXT_BUFFER_SIZE

config CAGENT_REQUEST_ARENA_EXTRA_SIZE
    int "Request arena extra margin"
    default 0
    help
      Extra bytes added to the automatically computed request arena.
      The base arena is derived from system/context, tool schema and
      messages buffers, so changing those buffers no longer requires
      updating another total-size option manually.

config CAGENT_SESSION_CONTENT_MAX_SIZE
    int "Maximum bytes per stored session message"
    default 1024 if CAGENT_CONFIG_PROFILE_TINY || CAGENT_PROFILE_TINY_DEFAULTS
    default 2048 if CAGENT_CONFIG_PROFILE_REACT || CAGENT_PROFILE_REACT_DEFAULTS
    default 2048

config CAGENT_SESSION_TOOL_CALL_MAX_SIZE
    int "Maximum bytes per stored session tool call arguments"
    default 128 if CAGENT_CONFIG_PROFILE_TINY || CAGENT_PROFILE_TINY_DEFAULTS
    default 512 if CAGENT_CONFIG_PROFILE_REACT || CAGENT_PROFILE_REACT_DEFAULTS
    default 256

config CAGENT_SESSION_MAX_TOOL_CALLS
    int "Maximum tool calls in one assistant message"
    default 2 if CAGENT_CONFIG_PROFILE_TINY || CAGENT_PROFILE_TINY_DEFAULTS
    default 8 if CAGENT_CONFIG_PROFILE_REACT || CAGENT_PROFILE_REACT_DEFAULTS
    default 4

config CAGENT_TOOL_ARGS_MAX_SIZE
    int "Maximum tool input JSON size"
    default 512 if CAGENT_CONFIG_PROFILE_TINY || CAGENT_PROFILE_TINY_DEFAULTS
    default 2048 if CAGENT_CONFIG_PROFILE_REACT || CAGENT_PROFILE_REACT_DEFAULTS
    default 1024

config CAGENT_TOOL_OUTPUT_MAX_SIZE
    int "Maximum tool output JSON size"
    default 512 if CAGENT_CONFIG_PROFILE_TINY || CAGENT_PROFILE_TINY_DEFAULTS
    default 2048 if CAGENT_CONFIG_PROFILE_REACT || CAGENT_PROFILE_REACT_DEFAULTS
    default 1024

endmenu

menu "Runtime limits"
    visible if CAGENT_ADVANCED_CONFIG

config CAGENT_DEFAULT_MAX_STEPS
    int "Default ReAct max steps"
    default 4 if CAGENT_CONFIG_PROFILE_TINY || CAGENT_PROFILE_TINY_DEFAULTS
    default 10 if CAGENT_CONFIG_PROFILE_REACT || CAGENT_PROFILE_REACT_DEFAULTS
    default 8

config CAGENT_DEFAULT_TIMEOUT_MS
    int "Default agent_run timeout in ms"
    default 15000 if CAGENT_CONFIG_PROFILE_TINY || CAGENT_PROFILE_TINY_DEFAULTS
    default 45000 if CAGENT_CONFIG_PROFILE_REACT || CAGENT_PROFILE_REACT_DEFAULTS
    default 30000

config CAGENT_DEFAULT_MODEL_TIMEOUT_MS
    int "Default per-model timeout in ms"
    default 10000 if CAGENT_CONFIG_PROFILE_TINY || CAGENT_PROFILE_TINY_DEFAULTS
    default 30000 if CAGENT_CONFIG_PROFILE_REACT || CAGENT_PROFILE_REACT_DEFAULTS
    default 15000

config CAGENT_DEFAULT_TOOL_TIMEOUT_MS
    int "Default per-tool timeout in ms"
    default 2000 if CAGENT_CONFIG_PROFILE_TINY || CAGENT_PROFILE_TINY_DEFAULTS
    default 5000 if CAGENT_CONFIG_PROFILE_REACT || CAGENT_PROFILE_REACT_DEFAULTS
    default 3000

config CAGENT_DEFAULT_MAX_OUTPUT_TOKENS
    int "Default model output token budget"
    default 256 if CAGENT_CONFIG_PROFILE_TINY || CAGENT_PROFILE_TINY_DEFAULTS
    default 768 if CAGENT_CONFIG_PROFILE_REACT || CAGENT_PROFILE_REACT_DEFAULTS
    default 512

endmenu

menu "Model providers"

config CAGENT_MODEL_OPENAI
    bool "Enable OpenAI-compatible model provider"
    default y

config CAGENT_MODEL_OPENAI_COMPAT
    bool "Enable legacy OpenAI-compatible adapter API"
    default y
    select CAGENT_MODEL_OPENAI

config CAGENT_MODEL_MOCK
    bool "Enable mock model provider"
    default y

endmenu

menu "Runtime platform"

config CAGENT_RUNTIME_OPENVELA_DEFAULTS
    bool
    default n

choice CAGENT_RUNTIME_PLATFORM
    prompt "cAGENT runtime platform"
    default CAGENT_RUNTIME_OPENVELA
    help
      Select the default runtime adapter used to fill agent_runtime_t when
      applications do not provide their own callbacks.

config CAGENT_RUNTIME_FALLBACK
    bool "No platform adapter (fallback callbacks only)"
    help
      Use libc/POSIX-style fallback callbacks only. http_post remains
      unsupported unless the application injects it.

config CAGENT_RUNTIME_OPENVELA
    bool "openvela/NuttX runtime"
    help
      Use the openvela/NuttX runtime adapter for allocator, time, sleep,
      logging, mutexes and optional HTTPS http_post.

endchoice

if CAGENT_RUNTIME_OPENVELA

config CAGENT_RUNTIME_OPENVELA_TLS
    bool "Enable mbedTLS HTTPS support in openvela runtime"
    default y
    select CRYPTO_MBEDTLS
    help
      Compile mbedTLS-based HTTPS http_post callback into the
      openvela runtime adapter.  When disabled, http_post remains
      NULL and must be provided by the application.

endif

endmenu

endif
```

## packages/cagent_addons/Kconfig
```kconfig
menuconfig CAGENT_ADDONS
    bool "cAGENT addons: node protocol and MCP bridge"
    default n
    help
      Optional addon package for cAGENT: OpenClaw Node protocol
      (multi-device collaboration, contest task B) and MCP gateway
      bridge (contest task C).

      Layering rule: the node protocol layer (CAGENT_ADDONS_NODE)
      builds without CAGENT so cAGENT-less node-role devices (e.g.
      demos/sensor_node) can use it; the gateway/glue and MCP modules
      depend on CAGENT public API only.

      See openvela_smarthome/docs/cagent-addons-design-rev2.md.

if CAGENT_ADDONS

menu "Modules"

config CAGENT_ADDONS_NODE
    bool "OpenClaw Node protocol layer (WebSocket + frames)"
    default y
    help
      Platform-independent protocol layer: WebSocket framing and
      OpenClaw Node frame codec. Does not depend on CAGENT.
    select NETUTILS_CJSON

config CAGENT_ADDONS_NODE_CLIENT
    bool "Node role (connect to a gateway, serve invokes)"
    default n
    depends on CAGENT_ADDONS_NODE
    help
      Node-role endpoint: connects to a gateway over WebSocket,
      answers connect.challenge, serves node.invoke requests from a
      local command table. No CAGENT dependency.

config CAGENT_ADDONS_NODE_GATEWAY
    bool "Gateway role (accept nodes, expose remote tools to cAGENT)"
    default n
    depends on CAGENT_ADDONS_NODE && CAGENT
    help
      Gateway role: accepts node connections, registers node tools
      into a cAGENT agent as node_<id>_<command>, dispatches invokes.

config CAGENT_ADDONS_MCP
    bool "Standard MCP Streamable HTTP client"
    default n
    depends on CAGENT
    select NETUTILS_CJSON
    help
      Standard MCP Streamable HTTP tools-only client. Connects directly
      to one configured MCP Server, runs initialize/tools/list/tools/call,
      and registers allowlisted external tools into cAGENT as
      mcp_<server>_<tool>. Does not support stdio, SSE streams or OAuth.

endmenu

menu "Capacity limits"

config CAGENT_ADDONS_MAX_NODES
    int "Maximum connected nodes (gateway)"
    default 4
    range 1 8
    depends on CAGENT_ADDONS_NODE_GATEWAY

config CAGENT_ADDONS_MAX_NODE_COMMANDS
    int "Maximum commands per node"
    default 8
    range 1 16
    depends on CAGENT_ADDONS_NODE

config CAGENT_ADDONS_RECV_BUF_SIZE
    int "Single WebSocket frame receive buffer size"
    default 4096
    range 512 16384
    depends on CAGENT_ADDONS_NODE

config CAGENT_ADDONS_WS_CONNECT_TIMEOUT_MS
    int "WebSocket TCP/Upgrade timeout in ms"
    default 5000
    range 500 30000
    depends on CAGENT_ADDONS_NODE

config CAGENT_ADDONS_WS_IO_TIMEOUT_MS
    int "WebSocket control-frame I/O timeout in ms"
    default 2000
    range 100 10000
    depends on CAGENT_ADDONS_NODE

config CAGENT_ADDONS_TRANSPORT_STACK_SIZE
    int "WebSocket accept/reader thread stack size"
    default 8192
    range 4096 32768
    depends on CAGENT_ADDONS_NODE

config CAGENT_ADDONS_NODE_CLIENT_STACK_SIZE
    int "Node client supervisor/command worker stack size"
    default 8192
    range 4096 32768
    depends on CAGENT_ADDONS_NODE_CLIENT

config CAGENT_ADDONS_NODE_QUEUE_SIZE
    int "Node client invoke queue depth"
    default 4
    range 1 16
    depends on CAGENT_ADDONS_NODE_CLIENT

config CAGENT_ADDONS_MAX_PENDING
    int "Maximum concurrent invokes (gateway)"
    default 4
    range 1 16
    depends on CAGENT_ADDONS_NODE_GATEWAY

config CAGENT_ADDONS_INVOKE_TIMEOUT_MS
    int "Node invoke timeout in ms"
    default 10000
    range 100 60000
    depends on CAGENT_ADDONS_NODE_GATEWAY

config CAGENT_ADDONS_GATEWAY_STACK_SIZE
    int "Gateway control worker stack size"
    default 8192
    range 4096 32768
    depends on CAGENT_ADDONS_NODE_GATEWAY

config CAGENT_ADDONS_MCP_RESPONSE_BUF_SIZE
    int "MCP HTTP response buffer size"
    default 4096
    range 512 16384
    depends on CAGENT_ADDONS_MCP

config CAGENT_ADDONS_MCP_PROTOCOL_VERSION
    string "MCP protocol version"
    default "2025-03-26"
    depends on CAGENT_ADDONS_MCP
    help
      Dated protocol version used by the direct MCP Client Profile.
      Changing this requires matching JSON-RPC fixtures and server tests.

config CAGENT_ADDONS_MAX_NODE_TOOLS
    int "Maximum globally registered Node tools"
    default 8
    range 0 32
    depends on CAGENT_ADDONS_NODE_GATEWAY

config CAGENT_ADDONS_MAX_MCP_TOOLS
    int "Maximum globally registered MCP tools"
    default 4
    range 0 16
    depends on CAGENT_ADDONS_MCP

config CAGENT_ADDONS_MAX_REMOTE_TOOLS
    int "Maximum globally registered remote tools"
    default 12
    range 1 48
    depends on CAGENT_ADDONS_NODE_GATEWAY || CAGENT_ADDONS_MCP

config CAGENT_ADDONS_MAX_PUBLIC_NAME_SIZE
    int "Maximum public tool name length"
    default 64
    range 32 128

config CAGENT_ADDONS_MAX_DESCRIPTION_SIZE
    int "Maximum remote tool description length"
    default 256
    range 64 1024

config CAGENT_ADDONS_MAX_SCHEMA_SIZE
    int "Maximum remote tool input schema length"
    default 1024
    range 128 4096

config CAGENT_ADDONS_MAX_RESULT_SIZE
    int "Maximum remote tool result length"
    default 4096
    range 512 16384

endmenu

endif
```
